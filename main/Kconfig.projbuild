## main/Kconfig.projbuild
```kconfig
menu "App Configuration"

    config CONSOLE_MAX_COMMAND_LINE_LENGTH
        int "Maximum command line length"
        default 1024
        help
            Maximum length of a single console command line.

    config APP_BLE_DEVICE_NAME
        string "BLE device name"
        default "TempChart-S3"
        help
            GAP device name advertised over BLE (NimBLE bleprph style).

    config APP_OTA_FIRMWARE_URL
        string "OTA firmware HTTPS URL (default)"
        default "https://192.168.1.100:8070/smart_tempchart.bin"
        help
            Default OTA URL when NVS has no saved value.
            Use the same CA cert as server_certs/ca_cert.pem for HTTPS.

    config APP_OTA_SERVER_PORT
        int "OTA server port"
        default 8070
        help
            HTTPS port used when building OTA URL from IP/host via ota_url set.

    config APP_OTA_FIRMWARE_PATH
        string "OTA firmware path"
        default "/smart_tempchart.bin"
        help
            Firmware path appended when building OTA URL from IP/host via ota_url set.

    config APP_OTA_RECV_TIMEOUT
        int "OTA receive timeout (ms)"
        default 120000
        help
            HTTP receive timeout for OTA download.

    config APP_NTP_SERVER
        string "NTP server hostname"
        default "ntp.aliyun.com"
        help
            SNTP server used by the ntp sync console command.

    config APP_NTP_TIMEZONE
        string "Timezone (TZ format)"
        default "CST-8"
        help
            POSIX TZ string applied before converting network time to local time.
            Example for China: CST-8

    config APP_NTP_SYNC_TIMEOUT
        int "NTP sync timeout (ms)"
        default 10000
        help
            Maximum wait time for SNTP synchronization.

endmenu
```
